## boards/shields/kometa/Kconfig.defconfig
```kconfig
if SHIELD_KOMETA_DONGLE

config ZMK_KOMETA
    default "KOMETA"

config ZMK_SPLIT_ROLE_CENTRAL
    default y

config ZMK_SPLIT
    default y

config ZMK_SPLIT_BLE_CENTRAL_PERIPHERALS
    default 2

config BT_MAX_CONN
    default 5

config BT_MAX_PAIRED
    default 5

endif

if SHIELD_KOMETA_LEFT || SHIELD_KOMETA_RIGHT || SHIELD_KOMETA_DONGLE

config ZMK_BLE
    default y

endif
```
